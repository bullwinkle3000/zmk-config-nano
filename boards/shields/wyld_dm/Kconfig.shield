## boards/shields/wyld_dm/Kconfig.shield
```kconfig
# config SHIELD_WYLD_DM
#     bool

config SHIELD_WYLD_DM_LEFT
    def_bool $(shields_list_contains,wyld_dm_left)
#     select SHIELD_WYLD_DM

config SHIELD_WYLD_DM_RIGHT
    def_bool $(shields_list_contains,wyld_dm_right)
#     select SHIELD_WYLD_DM
```

## config/boards/shields/wyld_dm/Kconfig.defconfig
```kconfig
if SHIELD_WYLD_DM_RIGHT

config ZMK_KEYBOARD_NAME
    default "Wyld DM"

config ZMK_SPLIT_ROLE_CENTRAL
    default y

endif

if SHIELD_WYLD_DM_LEFT || SHIELD_WYLD_DM_RIGHT

config ZMK_SPLIT
    default y

endif
```

## config/boards/shields/wyld_dm/Kconfig.shield
```kconfig
# config SHIELD_WYLD_DM
#     bool

config SHIELD_WYLD_DM_LEFT
    def_bool $(shields_list_contains,wyld_dm_left,nice_view_adapter)
#     select SHIELD_WYLD_DM

config SHIELD_WYLD_DM_RIGHT
    def_bool $(shields_list_contains,wyld_dm_right,nice_view_adapter)
#     select SHIELD_WYLD_DM
```

## config/west.yml
```yaml
manifest:
  remotes:
    - name: zmkfirmware
      url-base: https://github.com/zmkfirmware
  projects:
    - name: zmk
      remote: zmkfirmware
      revision: main
      import: app/west.yml
  self:
    path: config

#manifest:
#  remotes:
#    - name: zmkfirmware
#      url-base: https://github.com/petejohanson
#    - name: inorichi
#      url-base: https://github.com/inorichi
#  projects:
#    - name: zmk
#      remote: zmkfirmware
#      revision: feat/pointers-move-scroll
#      import: app/west.yml
#    - name: zmk-pmw3610-driver
#      remote: inorichi
#      revision: main
#  self:
#    path: config
```
